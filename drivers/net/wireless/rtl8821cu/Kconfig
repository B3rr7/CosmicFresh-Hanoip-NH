## drivers/net/wireless/rtl8821cu/Kconfig
```kconfig
config RTL8821CU
	tristate "Realtek RTL8821CU USB WiFi"
	depends on USB
	select CFG80211
	select MAC80211
	help
	  Realtek RTL8821CU USB WiFi driver with monitor and injection support.
```
